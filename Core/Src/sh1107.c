
#include "sh1107.h"
#include <string.h>

// Der Controller ist intern 64 Spalten x 128 Zeilen (16 Pages a 8 Zeilen).
// Logisch (quer, 128x64) wird um 90 Grad gedreht, wie setRotation(1) bei Adafruit.
#define NATIVE_W 64
#define NATIVE_PAGES 16

#define CTRL_CMD 0x00
#define CTRL_DATA 0x40

static I2C_HandleTypeDef *sh1107_i2c;
static uint8_t buffer[NATIVE_W * NATIVE_PAGES];

// 5x7 ASCII-Font 0x20..0x7F, je 5 Spaltenbytes (Bit 0 = oben). 0x7F = Gradzeichen.
static const uint8_t font5x7[][5] = {
    {0x00, 0x00, 0x00, 0x00, 0x00}, // ' '
    {0x00, 0x00, 0x5F, 0x00, 0x00}, // !
    {0x00, 0x07, 0x00, 0x07, 0x00}, // "
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    {0x08, 0x08, 0x2A, 0x1C, 0x08}, // 0x82: Pfeil rechts
};
#define FONT_LAST (0x20 + sizeof(font5x7) / sizeof(font5x7[0]) - 1)

static HAL_StatusTypeDef sendCommands(const uint8_t *cmds, uint16_t len)
{
    return HAL_I2C_Mem_Write(sh1107_i2c, SH1107_ADDR << 1, CTRL_CMD, I2C_MEMADD_SIZE_8BIT, (uint8_t *)cmds, len, 100);
}

HAL_StatusTypeDef SH1107_Init(I2C_HandleTypeDef *hi2c)
{
    // Init-Sequenz fuer das 128x64 FeatherWing (entspricht Adafruit_SH1107 fuer 64x128)
    static const uint8_t init[] = {
        0xAE,       // Display aus
        0xD5, 0x51, // Taktteiler
        0x20,       // Page-Adressierung
        0x81, SH1107_CONTRAST_NORMAL, // Kontrast
        0xAD, 0x8A, // DC-DC an
        0xA0,       // Segment-Remap normal
        0xC0,       // COM-Scan aufsteigend
        0xDC, 0x00, // Startzeile 0
        0xD3, 0x60, // Display-Offset
        0xD9, 0x22, // Precharge
        0xDB, 0x35, // VCOM
        0xA8, 0x3F, // Multiplex 64
        0xA4,       // RAM-Inhalt anzeigen
        0xA6,       // nicht invertiert
    };
    static const uint8_t displayOn = 0xAF;

    sh1107_i2c = hi2c;
    if (HAL_I2C_IsDeviceReady(sh1107_i2c, SH1107_ADDR << 1, 3, 10) != HAL_OK)
        return HAL_ERROR;
    if (sendCommands(init, sizeof(init)) != HAL_OK)
        return HAL_ERROR;

    SH1107_Clear();
    if (SH1107_Update() != HAL_OK)
        return HAL_ERROR;

    HAL_Delay(100);
    return sendCommands(&displayOn, 1);
}

HAL_StatusTypeDef SH1107_SelfTest(uint32_t durationMs)
{
    // 0xA5: alle Pixel an, unabhaengig vom RAM-Inhalt. 0xA4: wieder RAM anzeigen
    const uint8_t allOn = 0xA5, normal = 0xA4;
    if (sendCommands(&allOn, 1) != HAL_OK)
        return HAL_ERROR;
    HAL_Delay(durationMs);
    return sendCommands(&normal, 1);
}

HAL_StatusTypeDef SH1107_SetContrast(uint8_t contrast)
{
    const uint8_t cmd[] = {0x81, contrast};
    return sendCommands(cmd, sizeof(cmd));
}

HAL_StatusTypeDef SH1107_SetDisplayOn(uint8_t on)
{
    const uint8_t cmd = on ? 0xAF : 0xAE;
    return sendCommands(&cmd, 1);
}

void SH1107_DrawVLine(uint8_t x, uint8_t y0, uint8_t y1)
{
    if (y0 > y1)
    {
        uint8_t tmp = y0;
        y0 = y1;
        y1 = tmp;
    }
    for (uint8_t y = y0; y <= y1; y++)
        SH1107_DrawPixel(x, y, 1);
}

void SH1107_Clear(void)
{
    memset(buffer, 0, sizeof(buffer));
}

void SH1107_DrawPixel(uint8_t x, uint8_t y, uint8_t on)
{
    if (x >= SH1107_WIDTH || y >= SH1107_HEIGHT)
        return;

    // Drehung: logisch (x, y) -> nativ (63 - y, x)
    uint8_t nx = (NATIVE_W - 1) - y;
    uint8_t ny = x;
    uint8_t *byte = &buffer[nx + (ny / 8) * NATIVE_W];

    if (on)
        *byte |= (1 << (ny & 7));
    else
        *byte &= ~(1 << (ny & 7));
}

static void drawChar(uint8_t x, uint8_t y, char c, uint8_t size)
{
    uint8_t ch = (uint8_t)c;
    if (ch < 0x20 || ch > FONT_LAST)
        ch = '?';
    const uint8_t *glyph = font5x7[ch - 0x20];

    for (uint8_t col = 0; col < 5; col++)
    {
        for (uint8_t row = 0; row < 7; row++)
        {
            if (glyph[col] & (1 << row))
            {
                for (uint8_t dx = 0; dx < size; dx++)
                    for (uint8_t dy = 0; dy < size; dy++)
                        SH1107_DrawPixel(x + col * size + dx, y + row * size + dy, 1);
            }
        }
    }
}

void SH1107_DrawString(uint8_t x, uint8_t y, const char *str, uint8_t size)
{
    while (*str)
    {
        if (x + 5 * size > SH1107_WIDTH)
            break;
        drawChar(x, y, *str++, size);
        x += 6 * size;
    }
}

HAL_StatusTypeDef SH1107_Update(void)
{
    for (uint8_t page = 0; page < NATIVE_PAGES; page++)
    {
        const uint8_t setPos[] = {0xB0 | page, 0x10, 0x00}; // Page, Spalte 0
        if (sendCommands(setPos, sizeof(setPos)) != HAL_OK)
            return HAL_ERROR;
        if (HAL_I2C_Mem_Write(sh1107_i2c, SH1107_ADDR << 1, CTRL_DATA, I2C_MEMADD_SIZE_8BIT,
                              &buffer[page * NATIVE_W], NATIVE_W, 100) != HAL_OK)
            return HAL_ERROR;
    }
    return HAL_OK;
}
